## boards/UABC-FIAD/eeg_signal_reader/Kconfig
```kconfig
# SPDX-License-Identifier: Apache-2.0

config HEAP_MEM_POOL_ADD_SIZE_BOARD
	int
	default 4096 if BOARD_EEG_SIGNAL_READER_ESP32_PROCPU
```

## boards/UABC-FIAD/eeg_signal_reader/Kconfig.eeg_signal_reader
```kconfig
# SPDX-License-Identifier: Apache-2.0

config BOARD_EEG_SIGNAL_READER
	select SOC_ESP32_WROVER_E_N4R8
	select SOC_ESP32_PROCPU if BOARD_EEG_SIGNAL_READER_ESP32_PROCPU
```

## boards/UABC-FIAD/eeg_signal_reader/board.yml
```yaml
board:
  name: eeg_signal_reader
  full_name: EEG Signal Reader
  vendor: UABC-FIAD
  socs:
  - name: esp32
```
